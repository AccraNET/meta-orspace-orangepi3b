## conf/layer.conf
```bitbake
# We have a conf and classes directory, append to BBPATH
BBPATH .= ":${LAYERDIR}"

# We have a recipes directory containing .bb and .bbappend files, add to BBFILES
BBFILES += "${LAYERDIR}/recipes*/*/*.bb \
            ${LAYERDIR}/recipes*/*/*.bbappend"

BBFILE_COLLECTIONS += "orspace"
BBFILE_PATTERN_orspace := "^${LAYERDIR}/"
BBFILE_PRIORITY_orspace = "9"

LAYERSERIES_COMPAT_orspace = "styhead walnascar"
#LAYERDEPENDS_raspberrypi = "core"

# The dynamic-layers directory hosts the extensions and layer specific
# modifications.
```

## conf/machine/opi3b.conf
```bitbake
# Machine configuration for the rk3566 on the orange pi 3b

# Tune file for the cortex a-55 processor used in the RK3566 soc
# - This includes configuration for the gcc cross compiler used for all compilation for the target hardware
# - Contains optimizations for the compiler too
require conf/machine/include/arm/armv8-2a/tune-cortexa55.inc


# This include file is required for when the SOC_FAMILY varibale is used.
# - It basically adds the SOC_FAMILY value to the machineovverides 
include conf/machine/include/soc-family.inc

# Specify the bootloader recipe.
EXTRA_IMAGEDEPENDS += "virtual/bootloader"
PREFERRED_PROVIDER_virtual/bootloader = "u-boot-orspace"
UBOOT_MACHINE = "orangepi-3b-rk3566_defconfig"



# Specify the linux kernel recipe
PREFERRED_PROVIDER_virtual/kernel = "linux-orangepi"

# Speifies the wic file used to create a complete disk image when "wic" is specified in "IMAGE_FSTYPES"
WKS_FILE = "orspace-pi3b.wks"

# Specifies the files that will be contained in the "bootimg-partition" specifier in the wic file (if any)
IMAGE_BOOT_FILES = "Image rk3566-orangepi-3b-v1.1.dtb"

# Specifies the file system formats the rootfs is transformed into
IMAGE_FSTYPES = "ext4 wic wic.bmap"

SOC_FAMILY = "rockchip"


MACHINE_EXTRA_RRECOMMENDS += "kernel-modules"

# This variable defines the serial consoles available on the target device.
# For a busybox based system, this variable adds entries into the inittab file to start getty processes on the specified serial ports.
SERIAL_CONSOLES = "1500000;ttyS0 1500000;ttyS1 1500000;ttyS2"
```

## wic/orspace-pi3b.wks
```
bootloader --ptable gpt
part --source rawcopy --sourceparams="file=u-boot-rockchip.bin" --align 32 --no-table
part --source bootimg-partition  --fstype=vfat --align 1024 --label boot
part --source rootfs --fstype=ext4 --align 1024
```
